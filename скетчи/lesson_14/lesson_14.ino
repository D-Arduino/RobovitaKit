// Проект "Джостик"

int x; //Создаём ячейку оси X для джостика
int y; //Создаём ячейку оси Y для джостика

void setup(){

Serial.begin(9600);//Инициализируем монитор порта

}
void loop(){
y = analogRead(A0);//Присваем ячейке Y значение входа A0
x = analogRead(A1);//Присваем ячейке X значение входа A1
  String a; //Создаём ячейку типа "String"

if(x > 537){  //Если ячейка Х больше определённого значения, то 
 a = "Вперёд";  //присваиваем ячейке "а" значение "Вперёд"
 Serial.println(String(a));  //И выводим её
}
if(x < 487){  //Если ячейка Х меньше определённого значения, то
 a = "Назад";  //присваиваем ячейке "а" значение "Назад"
 Serial.println(String(a));  //И выводим её
}
if(y > 537){  //Если ячейка Y больше определённого значения, то
 a = "Направо";  //присваиваем ячейке "а" значение "Направо"
 Serial.println(String(a));  //И выводим её
}
if(y < 487){  //Если ячейка Y меньше определённого значения, то
 a = "Налево";  //присваиваем ячейке "а" значение "Налево"
 Serial.println(String(a));  //И выводим её
}

if(analogRead(A2) == 0){
 a = "Жмяк";  //присваиваем ячейке "а" значение "Кнопка нажата"("Жмяк")
 Serial.println(String(a));  //И выводим её
}
delay(50); //Небольшая задержка
}
